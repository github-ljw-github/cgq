	GET common.s
	IMPORT RCC_CFG
	IMPORT TIM2_IRQHandler
	IMPORT TIM2_CFG
	IMPORT IO_CFG
	IMPORT CLK_CFG
	IMPORT cal_dis
	IMPORT SYSTICK_CLK_SOURCE
	IMPORT TIM3_CFG
	IMPORT IWDG_CFG
	PRESERVE8
	AREA    MY_DATA, DATA, READONLY
	EXPORT  __Vectors
__Vectors;       
	DCD     0x20004000;0x20004000          ; Top of Stack
	DCD     Reset_Handler       ; Reset Handler
	DCD  0,1,2,3,4,5,6,7,8,9,0,1,2,3,4,5,6,7,8,9
	DCD  0,1,2,3,4,5,6,7,8,9,0,1,2,3,4,5,6,7,8,9
	DCD  1,2
	DCD     TIM2_IRQHandler; TIM2
	
	AREA    MY_CODE, CODE, READONLY
Reset_Handler    PROC
	EXPORT  Reset_Handler   
	BL RCC_CFG
	BL CLK_CFG
	BL IO_CFG
	BL TIM2_CFG
	BL TIM3_CFG
	BL SYSTICK_CLK_SOURCE
	BL IWDG_CFG
	;初始化
	LDR R0,=SEG_CNT
	LDR R1,=0
	STR R1,[R0]
	LDR R0,=1000
	BL DELAY_MS
LOOP
	;触发至少10us的高电平
	BL TRIG_H
	LDR R0,=15
	BL DELAY_US
	;输出低电平
	BL TRIG_L
	LDR R1,=0
WAIT_ECHO1
	BL ECHO
	PUSH {R0}
	LDR R2,=0XFFFF
	ADD R1,#1
	CMP R1,R2
	BGE LOOP
	POP {R0}
	TST R0,#1
	BEQ WAIT_ECHO1;等待echo输出高电平
	;清空计数器,最大计数65535us 最大测量340*(65535/2000000)=11.1410m
	LDR R0,=TIM3_CNT
	LDR R1,[R0]
	LDR R1,=0
	STR R1,[R0]
WAIT_ECHO2
	BL ECHO
	TST R0,#1
	BEQ ECHO_OK2 
	B WAIT_ECHO2;等待echo输出低电平
ECHO_OK2	
	;读数据
	LDR R1,=TIM3_CNT
	LDR R0,[R1]
	;计算距离
	BL cal_dis
	;显示
	LDR R7,=0
	LDR R3,=10
DIS1
	SDIV R1,R0,R3
	MUL R1,R3    
	SUB R2,R0,R1 
	PUSH {R2}
	ADD R7,#1
	CMP R7,#4;
	BEQ DIS2
	SDIV R0,R3   
	B DIS1
DIS2
	BL UPDATE_SEG_CLRENA
DIS3
	POP {R0}
	CMP R7,#4
	BEQ SEG_BIT4
	CMP R7,#3
	BEQ SEG_BIT3
	CMP R7,#2
	BEQ SEG_BIT2
	CMP R7,#1
	BEQ SEG_BIT1
	B CNT_SUB1 
SEG_BIT4
	LDR R1,=SEG_QIAN
	STR R0,[R1]
	B CNT_SUB1 
SEG_BIT3
	LDR R1,=SEG_BAI
	STR R0,[R1]
	B CNT_SUB1 
SEG_BIT2
	LDR R1,=SEG_SHI
	STR R0,[R1]
	B CNT_SUB1 
SEG_BIT1
	LDR R1,=SEG_GE
	STR R0,[R1]
	B CNT_SUB1 
CNT_SUB1	
	ADD R7,#-1
	CMP R7,#0
	BNE DIS3
	BL UPDATE_SEG_SETENA
	;翻转LED状态	
	BL TURN_LED
	LDR R0,=500
	BL DELAY_MS
	B LOOP
	ENDP
UPDATE_SEG_SETENA PROC
	EXPORT UPDATE_SEG_SETENA
	PUSH {R14}
	LDR R0,=28
	BL NVIC_SETENA0_EN;允许刷新数码管
	POP {PC}
	ENDP
UPDATE_SEG_CLRENA PROC
	EXPORT UPDATE_SEG_CLRENA
	PUSH {R14}
	LDR R0,=28
	BL NVIC_CLREA0_EN
	POP {PC}
	ENDP
NVIC_CLREA0_EN PROC
	EXPORT NVIC_CLREA0_EN
	MOV R3,R0
	LDR R0,=NVIC_CLREA0
	LDR R1,[R0]
	LDR R2,=1
	LSL R2,R3
	ORR R1,R2
	STR R1,[R0];
	BX R14
	ENDP
NVIC_SETENA0_EN	PROC
	EXPORT NVIC_SETENA0_EN
	MOV R0,R3
	LDR R0,=NVIC_SETENA0
	LDR R1,[R0]
	LDR R2,=1
	LSL R2,R3
	ORR R1,R2
	STR R1,[R0]
	BX R14
	ENDP
DELAY_US PROC;最大延时：2,796,200us
	EXPORT DELAY_US
	;计算重载值
	LDR R1,=6
	MUL R0,R1
	;装入重载值
	LDR R1,=SYSTICK_RELOAD
	STR R0,[R1]
	;清空计数器
	LDR R0,=SYSTICK_CURRENT
	LDR R1,=0
	STR R1,[R0]
	;启动计时器
	LDR R0,=SYSTICK_CSR
	LDR R2,[R0]
	ORR R2,#1
	STR R2,[R0]
READ_CURRENTFLAG_US;等待时间到达	
	LDR R1,[R0]
	TST R1,#0X10000
	BEQ READ_CURRENTFLAG_US
	;关闭计时器
	LDR R0,=SYSTICK_CSR
	LDR R2,[R0]
	BIC R2,#1
	STR R2,[R0]
	BX R14
	ENDP
DELAY_MS PROC;最大延时2,796ms
	EXPORT DELAY_MS
	;计算重载值
	LDR R1,=6000
	MUL R0,R1
	;装入重载值
	LDR R1,=SYSTICK_RELOAD
	STR R0,[R1]
	;清空计数器
	LDR R0,=SYSTICK_CURRENT
	LDR R1,=0
	STR R1,[R0]
	;启动定时器
	LDR R0,=SYSTICK_CSR
	LDR R2,[R0]
	ORR R2,#1
	STR R2,[R0]
READ_CURRENTFLAG_MS;等待时间到达	
	LDR R1,[R0]
	TST R1,#0X10000
	BEQ READ_CURRENTFLAG_MS
	;关闭定时器
	LDR R0,=SYSTICK_CSR
	LDR R2,[R0]
	BIC R2,#1
	STR R2,[R0]
	BX R14
	ENDP
SET_AN  PROC
	EXPORT SET_AN
	MOV R3,R0
	LDR R0,=GPIOA_ODR
	LDR R1,[R0]
	LDR R2,=0X1
	LSL R2,R3
	ORR R1,R2
	STR R1,[R0]	
	BX  R14
	ENDP
RESET_AN  PROC
	EXPORT RESET_AN
	MOV R3,R0
	LDR R0,=GPIOA_ODR
	LDR R1,[R0]
	LDR R2,=0X1
	LSL R2,R3
	BIC R1,R2
	STR R1,[R0]
	BX  R14
	ENDP
SET_BN  PROC
	EXPORT SET_BN
	MOV R3,R0
	LDR R0,=GPIOB_ODR
	LDR R1,[R0]
	LDR R2,=0X1
	LSL R2,R3
	ORR R1,R2
	STR R1,[R0]	
	BX  R14
	ENDP
RESET_BN  PROC
	EXPORT RESET_BN
	MOV R3,R0
	LDR R0,=GPIOB_ODR
	LDR R1,[R0]
	LDR R2,=0X1
	LSL R2,R3
	BIC R1,R2
	STR R1,[R0]
	BX  R14
	ENDP	
READ_BN	PROC
	MOV R3,R0
	LDR R0,=GPIOB_IDR
	LDR R1,[R0]
	LDR R0,=0X1
	LSL R0,R3
	TST R1,R0
	LDRNE R0,=0X1
	LDREQ R0,=0X0
	BX R14
	ENDP
SET_CN  PROC
	EXPORT SET_CN
	MOV R3,R0
	LDR R0,=GPIOC_ODR
	LDR R1,[R0]
	LDR R2,=0X1
	LSL R2,R3
	ORR R1,R2
	STR R1,[R0]	
	BX  R14
	ENDP
RESET_CN  PROC
	EXPORT RESET_CN
	MOV R3,R0
	LDR R0,=GPIOC_ODR
	LDR R1,[R0]
	LDR R2,=0X1
	LSL R2,R3
	BIC R1,R2
	STR R1,[R0]
	BX  R14
	ENDP
TURN_CN  PROC
	EXPORT TURN_CN
	MOV R3,R0
	LDR R0,=GPIOC_ODR
	LDR R1,[R0]
	LDR R2,=0X1
	LSL R2,R3
	EOR R1,R2
	STR R1,[R0]
	BX  R14
	ENDP
TURN_LED PROC
	EXPORT TURN_LED
	PUSH {R14}
	LDR R0,=13
	BL TURN_CN
	POP {PC}
	ENDP
TRIG_H	PROC
	EXPORT TRIG_H
	PUSH {R14}
	LDR R0,=0X0
	BL SET_BN
	POP {PC}
	ENDP

TRIG_L	PROC
	EXPORT TRIG_L
	PUSH {R14}
	LDR R0,=0X0
	BL RESET_BN
	POP {PC}
	ENDP
		
ECHO	PROC
	EXPORT ECHO
	PUSH {R14}
	LDR R0,=0X1
	BL READ_BN
	POP {PC}
	ENDP
	ALIGN
	END;汇编代码结束
