
	GET common.s
	IMPORT cal_dis
	IMPORT ECHO
	IMPORT IWDG_FEED
	PRESERVE8
	AREA    MY_CODE, CODE, READONLY
TIM2_CFG PROC
	EXPORT TIM2_CFG
	PUSH {R14}
	;设置分频
	LDR R0,=TIM2_PSC
	LDR R1,=47
	STR R1,[R0]
	;设置周期
	LDR R0,=TIM2_ARR
	LDR R1,=5000
	STR R1,[R0]
	;使能更新中断
	LDR R0,=TIM2_DIER
	LDR R1,[R0]
	ORR R1,#0X1
	STR R1,[R0]
	;使能NVIC中断
	LDR R0,=NVIC_SETENA0
	LDR R1,[R0]
	LDR R2,=0X1
	LSL R2,#28
	ORR R1,R2
	STR R1,[R0]
	;使能计数器
	LDR R0,=TIM2_CR1
	LDR R1,[R0]
	LDR R2,=0X1
	ORR R1,R2
	STR R1,[R0]
	POP {PC}
	ENDP
TIM3_CFG PROC
	EXPORT TIM3_CFG
	PUSH {R14}
	;设置分频
	LDR R0,=TIM3_PSC
	LDR R1,=47;分频到微妙级
	STR R1,[R0]
	;设置周期
	LDR R0,=TIM3_ARR
	LDR R1,=65535
	STR R1,[R0]
	;开定时器
	LDR R0,=TIM3_CR1
	LDR R1,=1
	ORR R1,#1
	STR R1,[R0]
	POP {PC}
	ENDP
TIM2_IRQHandler PROC
	EXPORT TIM2_IRQHandler	
	PUSH {R14}
	LDR R0,=TIM2_SR
	LDR R1,[R0]
	LDR R2,=0X1
	TST R1,R2
	BLEQ OUT
	;;;;;;;;;;;;;;;
	LDR R0,=SEG_CNT
	LDR R1,[R0]
	ADD R1,#1
	STR R1,[R0]
	;;;
	CMP R1,#0
	BEQ UPDATA_SEG_QIAN
	CMP R1,#1
	BEQ UPDATA_SEG_BAI
	CMP R1,#2
	BEQ UPDATA_SEG_SHI
	CMP R1,#3
	BEQ UPDATA_SEG_GE
	CMP R1,#3
	BHI RESET_SEG_CNT
RESET_SEG_CNT
	LDR R0,=SEG_CNT
	LDR R1,=0
	STR R1,[R0]
	B UPDATA_SEG_QIAN
UPDATA_SEG_QIAN
	BL W1_ON
	BL W2_OFF
	BL W3_OFF
	BL W4_OFF
	BL DP_OFF
	LDR R0,=SEG_QIAN
	B UPDATE_SEG
UPDATA_SEG_BAI	
	BL W1_OFF
	BL W2_ON
	BL W3_OFF
	BL W4_OFF
	BL DP_OFF
	LDR R0,=SEG_BAI
	B UPDATE_SEG
UPDATA_SEG_SHI
	BL W1_OFF
	BL W2_OFF
	BL W3_ON
	BL W4_OFF
	BL DP_OFF
	LDR R0,=SEG_SHI
	B UPDATE_SEG
UPDATA_SEG_GE
	BL W1_OFF
	BL W2_OFF
	BL W3_OFF
	BL W4_ON
	BL DP_OFF
	LDR R0,=SEG_GE
	B UPDATE_SEG
UPDATE_SEG
	LDR R7,[R0]
	CMP R7,#0
	BLEQ SHOW0
	CMP R7,#1
	BLEQ SHOW1
	CMP R7,#2
	BLEQ SHOW2
	CMP R7,#3
	BLEQ SHOW3
	CMP R7,#4
	BLEQ SHOW4
	CMP R7,#5
	BLEQ SHOW5
	CMP R7,#6
	BLEQ SHOW6
	CMP R7,#7
	BLEQ SHOW7
	CMP R7,#8
	BLEQ SHOW8
	CMP R7,#9
	BLEQ SHOW9
	
	BL IWDG_FEED
	;;;;;;;;;;;;;;;
	;清除挂起标志
	LDR R0,=NVIC_CLRPEN
	LDR R1,[R0]
	LDR R2,=0X1
	LSL R2,#28
	ORR R1,R2
	STR R1,[R0]
	;清除中断标志位
	LDR R0,=TIM2_SR
	LDR R1,[R0]
	LDR R2,=0X1
	BIC R1,R2
	STR R1,[R0]
OUT	
	POP {PC}
	ENDP
IO_CFG  PROC;配置GPIO
	EXPORT IO_CFG
	;配置A0-A7为推挽输出，最大速率
	LDR R0,=GPIOA_CRL
	LDR R2,[R0]
	AND R1,R2,#0X00000000
	LDR R2,=0x33333333
	EOR R1,R2
	STR R1,[R0]
	;配置B0,B4-B7推挽输出，最大速率
	LDR R0,=GPIOB_CRL
	LDR R2,[R0]
	LDR R3,=0X0000FFF0
	AND R1,R2,R3
	LDR R2,=0x33330003
	ORR R1,R2
	STR R1,[R0]
	;配置B8-B9推挽输出，最大速率
	LDR R0,=GPIOB_CRH
	LDR R2,[R0]
	AND R1,R2,#0XFFFFFF00
	LDR R2,=0x00000033
	ORR R1,R2
	STR R1,[R0]
	;配置B1为输入,带拉电阻
	LDR R0,=GPIOB_CRL
	LDR R2,[R0]
	AND R1,R2,#0XFFFFFF0F
	ORR R1,#0X80
	STR R1,[R0]
	;配置C13为推挽输出
	LDR R0,=GPIOC_CRH
	LDR R2,[R0]
	AND R1,R2,#0XFF0FFFFF
	LDR R2,=0x00300000
	ORR R1,R2
	STR R1,[R0]
	BX R14
	ENDP
	ALIGN
	END