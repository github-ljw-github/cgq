	GET common.s
	AREA MY_DATA, DATA,READWRITE
VAR1	DCD 0
VAR2 	DCD 0
VAR3    DCD 0
	EXPORT VAR1
	EXPORT VAR2
	EXPORT VAR3
	AREA    MY_CODE, CODE, READONLY
RCC_CFG PROC
	EXPORT RCC_CFG 
	PUSH {R14}
	LDR R0,=RCC_CR
	LDR R1,[R0]
	LDR R2,=0X1
	LSL R2,#16
	ORR R1,R2
	STR R1,[R0]
	
	LDR R2,=0X1
	LSL R2,#17
HSE_RDY
	LDR R1,[R0]
	TST R1,R2
	BLEQ HSE_RDY
	LDR R0,=RCC_CFGR
	LDR R1,[R0]
	LDR R2,=0X1
	LSL R2,#17
	BIC R1,R2;不分频
	LDR R2,=0X1
	LSL R2,#16
	ORR R1,R2;HSE为PLL时钟源
	LDR R2,=0X4
	LSL R2,#18
	ORR R1,R2;倍频指数
	LDR R2,=0XFFF;0000 0000 0000
	LSL R2,#4
	BIC R1,R2;不分频
	STR R1,[R0]
	
	LDR R0,=RCC_CR
	LDR R1,[R0]
	LDR R2,=0X1
	LSL R2,#24
	ORR R1,R2
	STR R1,[R0]
	
	LDR R2,=0X1
	LSL R2,#25
PLL_RDY
	LDR R1,[R0]
	TST R1,R2
	BLEQ PLL_RDY
	LDR R0,=RCC_CFGR
	LDR R1,[R0]
	LDR R2,=0X3
	BIC R1,R2
	LDR R2,=0X2
	ORR R1,R2
	STR R1,[R0]
	LDR R0,=RCC_CFGR
SYS_PLL		
	LDR R1,[R0]
	LSR R2,R1,#2
	AND R2,#0X2
	TST R2,#0X2
	BLEQ SYS_PLL
	
	POP {PC}
	ENDP
CLK_CFG	PROC;使能GPIOA、GPIOB、GPIOC时钟
	EXPORT CLK_CFG
	LDR R0,=RCC_APB2ENR
	LDR R1,[R0]
	LDR R2,=0X7
	LSL R2,#2;
	EOR R1,R2
	STR R1,[R0]
	
	;使能TIM2、TIM3时钟
	LDR R0,=RCC_APB1ENR
	LDR R1,[R0]
	LDR R2,=0X3
	LSL R2,#0
	ORR R1,R2
	STR R1,[R0]
	BX R14
	ENDP
SYSTICK_CLK_SOURCE PROC
	EXPORT SYSTICK_CLK_SOURCE
	LDR R0,=SYSTICK_CSR
	LDR R1,[R0]
	BIC R1,#4
	STR R1,[R0]
	BX R14
	ENDP	
IWDG_CFG PROC
	EXPORT IWDG_CFG
	LDR R0,=IWDG_PR
	LDR R1,[R0]
	LDR R2,=0X3
	BIC R1,R2
	STR R1,[R0]
	LDR R0,=IWDG_RLR
	LDR R1,=0XFFF
	STR R1,[R0]
	LDR R0,=IWDG_KR
	LDR R1,=0XCCCC
	STR R1,[R0]
	BX R14
	ENDP
IWDG_FEED PROC
	EXPORT IWDG_FEED
	LDR R0,=IWDG_KR
	LDR R1,=0XAAAA
	STR R1,[R0]	
	BX R14
	ENDP
	ALIGN
	END